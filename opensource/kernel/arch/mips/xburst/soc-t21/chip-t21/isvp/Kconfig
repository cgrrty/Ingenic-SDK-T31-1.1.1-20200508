## opensource/kernel/arch/mips/xburst/soc-t21/chip-t21/isvp/Kconfig
```kconfig
choice
	prompt "Board type"
	depends on PLATFORM_T21_ISVP
	default BOARD_TURKEY

config BOARD_TURKEY
       bool "Turkey"
       depends on PLATFORM_T21_ISVP

endchoice

config BOARD_NAME
	string
	default "Turkey" if BOARD_TURKEY
```

## opensource/kernel/arch/mips/xburst/soc-t30/chip-t30/Kconfig
```kconfig
choice
	prompt "Platform type"
	depends on CHIP_T30
	default PLATFORM_T30_ISVP

config PLATFORM_T30_ISVP
	bool "isvp"

endchoice

config PRODUCT_NAME
	string
	default "isvp" if PLATFORM_T30_ISVP

if PLATFORM_T30_ISVP
source "arch/mips/xburst/soc-t30/chip-t30/isvp/Kconfig"
endif
```

## opensource/kernel/arch/mips/xburst/soc-t30/chip-t30/isvp/Kconfig
```kconfig
choice
	prompt "Board type"
	depends on PLATFORM_T30_ISVP
	default BOARD_MONKEY

config BOARD_MONKEY
       bool "Monkey"
       depends on PLATFORM_T30_ISVP

endchoice

config BOARD_NAME
	string
	default "Monkey" if BOARD_MONKEY
```

## opensource/kernel/drivers/video/avpu/Kconfig
```kconfig
menuconfig AVPU
	bool "AVPU video codec drivers"
	default n
	help
	  Enable AVPU video codec drivers

if AVPU
config AVPU_NO_DMABUF
	depends on AVPU
	int "vpu not use dmabuf"
	default 1
source "drivers/video/avpu/jz_avpu/Kconfig"
endif
```

## opensource/kernel/drivers/video/soc_vpu/radix/Kconfig
```kconfig
config VPU_RADIX
    depends on SOC_VPU && !JZ_NVPU && !AVPU
    bool "vpu radix client device of soc_vpu begin with t30 soc"
    default n

if VPU_RADIX
config VPU_RADIX_NUM
    depends on VPU_RADIX
    int "vpu radix node number"
    default 1
endif
```
